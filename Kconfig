## port/stm32f1/Kconfig.parts
```kconfig
config MCU_STM32F103XB
	bool "STM32F103x8 / STM32F103xB (64 / 128 KiB, medium density)"
	select FAMILY_STM32F1
```

## port/stm32h7/Kconfig
```kconfig
# STM32H7 options.

choice PWR_SUPPLY_CHOICE
	prompt "Power supply"
	depends on FAMILY_STM32H7
	default PWR_SUPPLY_LDO
	help
	  How the core domain is supplied (RM0399 "PWR_CR3"). MUST match the
	  hardware and the application: the register can be written only once per
	  power-up.

config PWR_SUPPLY_LDO
	bool "LDO"
config PWR_SUPPLY_DIRECT_SMPS
	bool "SMPS direct"
config PWR_SUPPLY_SMPS_1V8_LDO
	bool "SMPS 1.8 V -> LDO"
config PWR_SUPPLY_SMPS_2V5_LDO
	bool "SMPS 2.5 V -> LDO"
config PWR_SUPPLY_SMPS_1V8_EXT_LDO
	bool "SMPS 1.8 V -> external and LDO"
config PWR_SUPPLY_SMPS_2V5_EXT_LDO
	bool "SMPS 2.5 V -> external and LDO"
config PWR_SUPPLY_SMPS_1V8_EXT
	bool "SMPS 1.8 V -> external, LDO bypassed"
config PWR_SUPPLY_SMPS_2V5_EXT
	bool "SMPS 2.5 V -> external, LDO bypassed"
config PWR_SUPPLY_EXTERNAL
	bool "External supply (bypass)"
endchoice

config PWR_SUPPLY
	int
	default 1 if PWR_SUPPLY_LDO
	default 2 if PWR_SUPPLY_DIRECT_SMPS
	default 3 if PWR_SUPPLY_SMPS_1V8_LDO
	default 4 if PWR_SUPPLY_SMPS_2V5_LDO
	default 5 if PWR_SUPPLY_SMPS_1V8_EXT_LDO
	default 6 if PWR_SUPPLY_SMPS_2V5_EXT_LDO
	default 7 if PWR_SUPPLY_SMPS_1V8_EXT
	default 8 if PWR_SUPPLY_SMPS_2V5_EXT
	default 9 if PWR_SUPPLY_EXTERNAL

config SHARED_RAM_ADDR
	hex
	depends on FAMILY_STM32H7
	default 0x3800FE00 if DUALCORE_PER_CORE && CORE_CM4
	default 0x3800FF00
	help
	  The handoff area, end of SRAM4 (D3 domain, reachable by both cores, kept
	  over reset); each bootloader of PER_CORE has its own.
```

## port/stm32h7/Kconfig.parts
```kconfig
config MCU_STM32H742XX
	bool "STM32H742xx"
	select FAMILY_STM32H7
config MCU_STM32H743XX
	bool "STM32H743xx"
	select FAMILY_STM32H7
config MCU_STM32H753XX
	bool "STM32H753xx"
	select FAMILY_STM32H7
config MCU_STM32H745XX
	bool "STM32H745xI (dual core)"
	select FAMILY_STM32H7
	select MCU_DUALCORE
config MCU_STM32H745XG
	bool "STM32H745xG (dual core)"
	select FAMILY_STM32H7
	select MCU_DUALCORE
config MCU_STM32H747XX
	bool "STM32H747xI (dual core)"
	select FAMILY_STM32H7
	select MCU_DUALCORE
config MCU_STM32H747XG
	bool "STM32H747xG (dual core)"
	select FAMILY_STM32H7
	select MCU_DUALCORE
config MCU_STM32H755XX
	bool "STM32H755xI (dual core)"
	select FAMILY_STM32H7
	select MCU_DUALCORE
config MCU_STM32H757XX
	bool "STM32H757xI (dual core)"
	select FAMILY_STM32H7
	select MCU_DUALCORE
```
